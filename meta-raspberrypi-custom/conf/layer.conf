## meta-raspberrypi-custom/conf/layer.conf
```bitbake
# We have a conf and classes directory, add to BBPATH
BBPATH .= ":${LAYERDIR}"

# We have recipes-* directories, add to BBFILES
BBFILES += "${LAYERDIR}/recipes-*/*/*.bb \
            ${LAYERDIR}/recipes-*/*/*.bbappend"

BBFILE_COLLECTIONS += "meta-raspberrypi-custom"
BBFILE_PATTERN_meta-raspberrypi-custom = "^${LAYERDIR}/"
BBFILE_PRIORITY_meta-raspberrypi-custom = "6"

LAYERDEPENDS_meta-raspberrypi-custom = "core raspberrypi"
LAYERSERIES_COMPAT_meta-raspberrypi-custom = "scarthgap"

# Enable systemd as init system
DISTRO_FEATURES:append = " systemd usrmerge"
DISTRO_FEATURES_BACKFILL_CONSIDERED = "sysvinit"
VIRTUAL-RUNTIME_init_manager = "systemd"
VIRTUAL-RUNTIME_initscripts = ""
```

## meta-raspberrypi-custom/conf/machine/raspberrypi4-64-custom.conf
```bitbake
#@TYPE: Machine
#@NAME: RaspberryPi 4 Development Board (64bit) - Custom
#@DESCRIPTION: RaspberryPi 4 (64bit) with an additional custom DTB

# Inherit the standard Raspberry Pi 4 (64bit) settings (kernel image name, firmware,
# default DTBs, config.txt generation, etc.)
require conf/machine/raspberrypi4-64.conf

# IMPORTANT: don't replace the default DTB list.
# The RPi firmware will usually pick bcm2711-rpi-4-b.dtb automatically unless
# config.txt sets device_tree=..., so keep the defaults and add our custom DTB.
RPI_KERNEL_DEVICETREE:append = " broadcom/bcm2711-rpi-4-b-custom.dtb"

# Override boot partition label to be within FAT32 11-character limit
BOOTDD_VOLUME_ID = "RPI4-CUSTOM"

WKS_FILE = "sdimage-raspberrypi4-custom.wks"
```
